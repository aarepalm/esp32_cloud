## projects/security_cam/firmware/main/Kconfig.projbuild
```kconfig
menu "Security Camera Configuration"

    config WIFI_SSID
        string "WiFi SSID"
        default "your-wifi-ssid"
        help
            SSID of the WiFi network to connect to.

    config WIFI_PASSWORD
        string "WiFi Password"
        default "your-wifi-password"
        help
            Password for the WiFi network.

    config DEVICE_ID
        string "Device ID"
        default "esp32-eye-01"
        help
            Unique device identifier included in clip filenames and S3 paths.

    config LAMBDA_PRESIGN_URL
        string "Lambda presign function URL"
        default "https://your-lambda-function-url/presign"
        help
            HTTPS URL of the Lambda Function URL that returns presigned S3 PUT URLs.
            Format: https://<id>.lambda-url.eu-north-1.on.aws/presign

    config API_KEY
        string "Presign endpoint API key"
        default "your-api-key"
        help
            Shared secret sent as x-api-key header to the presign Lambda.
            Must match presign_api_key in terraform.tfvars.
            Set in sdkconfig.defaults.local (never commit the real value).

    config MOTION_THRESHOLD
        int "Motion detection threshold (changed pixels)"
        default 2000
        range 1 76800
        help
            Number of changed pixels in the QVGA (320x240 = 76800 pixel) grayscale
            frame required to trigger recording. Lower = more sensitive.
            2000 = ~2.6% of frame, good starting point for indoor cameras.

    config MAX_CLIP_SECONDS
        int "Maximum clip length (seconds)"
        default 60
        range 5 120
        help
            Clip is closed and a new one started if motion continues past this duration.

    config RECORD_FPS
        int "Recording frame rate (fps)"
        default 10
        range 1 30
        help
            Target frame rate during RECORD mode. Actual rate depends on camera
            and SD card speed.

endmenu
```

## projects/security_cam/firmware/sdkconfig.defaults
```kconfig
# Common sdkconfig defaults — safe to commit (no credentials)
# Applied to all targets before the target-specific layer.

# TLS — use full CA bundle so we can verify AWS certificates
CONFIG_MBEDTLS_CERTIFICATE_BUNDLE=y
CONFIG_MBEDTLS_CERTIFICATE_BUNDLE_DEFAULT_FULL=y

# PSRAM — enable; exact mode set per target
CONFIG_SPIRAM=y
CONFIG_SPIRAM_USE_MALLOC=y

# FAT filesystem for SD card
CONFIG_FATFS_LFN_HEAP=y
CONFIG_FATFS_MAX_LFN=255

# FreeRTOS task stack sizes — generous defaults for camera + network tasks
CONFIG_ESP_MAIN_TASK_STACK_SIZE=8192

# Partition table — use "single factory app, no OTA" with a 3MB app partition
# The default 1MB partition is too small once WiFi + HTTPS + FATFS are all included.
CONFIG_PARTITION_TABLE_SINGLE_APP_LARGE=y

# Camera: enable PSRAM DMA mode on S3 — avoids bounce-buffer path where event
# queue depth=1 causes guaranteed VSYNC-OVF and camera task hang on S3-EYE.
CONFIG_CAMERA_PSRAM_DMA=y

# Logging
CONFIG_LOG_DEFAULT_LEVEL_INFO=y

# App-level config — placeholders overridden in sdkconfig.defaults.local
CONFIG_WIFI_SSID="your-wifi-ssid"
CONFIG_WIFI_PASSWORD="your-wifi-password"
CONFIG_DEVICE_ID="esp32-eye-01"
CONFIG_LAMBDA_PRESIGN_URL="https://your-lambda-function-url/presign"
CONFIG_MOTION_THRESHOLD=6144
CONFIG_MAX_CLIP_SECONDS=60
CONFIG_RECORD_FPS=10
```

## projects/security_cam/firmware/sdkconfig.defaults.esp32p4
```kconfig
# ESP32-P4 specific sdkconfig — ESP32-P4-FunctionalEVBoard
# Applied after sdkconfig.defaults, before sdkconfig.defaults.local
# Phase 2 — stub until P4 bring-up begins

# CPU — P4 HP core at 400MHz
CONFIG_ESP_DEFAULT_CPU_FREQ_MHZ_400=y

# PSRAM — P4 has large on-chip RAM, external PSRAM details TBD
# CONFIG_SPIRAM=n  # Uncomment if P4 board lacks external PSRAM

# WiFi via esp_hosted (ESP32-C6 companion chip over SDIO)
# esp_hosted component must be in the component path
# CONFIG_ESP_HOSTED_SDIO_CLK=... (pin assignments TBD from P4 board schematic)
```

## projects/security_cam/firmware/sdkconfig.defaults.esp32s3
```kconfig
# ESP32-S3 specific sdkconfig — ESP32-S3-EYE board
# Applied after sdkconfig.defaults, before sdkconfig.defaults.local

# Console — route stdin/stdout through native USB Serial/JTAG (ttyACM0)
# ESP32-S3-EYE has no separate USB-UART chip; UART0 is not wired to USB.
CONFIG_ESP_CONSOLE_USB_SERIAL_JTAG=y

# CPU
CONFIG_ESP_DEFAULT_CPU_FREQ_MHZ_240=y

# Flash
CONFIG_ESPTOOLPY_FLASHSIZE_8MB=y

# PSRAM — OPI PSRAM on S3-EYE
CONFIG_SPIRAM_MODE_OCT=y
CONFIG_SPIRAM_SPEED_80M=y

# Camera pin assignments are hardcoded in camera_hal_s3.c (board-specific constants).
# esp_camera component does not expose pin Kconfig symbols.
```

## projects/security_cam/firmware/sdkconfig.defaults.local.example
```kconfig
# sdkconfig.defaults.local — device secrets (gitignored, never commit)
# Copy this file to sdkconfig.defaults.local and fill in your values.
# Then build: idf.py build flash monitor -p /dev/ttyACM0

CONFIG_WIFI_SSID="your-wifi-ssid"
CONFIG_WIFI_PASSWORD="your-wifi-password"
CONFIG_LAMBDA_PRESIGN_URL="https://xxx.execute-api.eu-north-1.amazonaws.com"
CONFIG_DEVICE_ID="cam01"
CONFIG_API_KEY="your-presign-api-key"
```
